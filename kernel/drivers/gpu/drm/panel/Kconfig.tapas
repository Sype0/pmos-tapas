## kernel/drivers/gpu/drm/panel/Kconfig.tapas
```kconfig
config DRM_PANEL_XIAOMI_M7_38_0C_0A
	tristate "Xiaomi tapas m7 38 0c 0a DSI panel"
	depends on GPIOLIB
	depends on OF
	depends on DRM_MIPI_DSI
	depends on BACKLIGHT_CLASS_DEVICE
	select DRM_DISPLAY_DSC_HELPER
	select DRM_DISPLAY_HELPER
	help
	  Say Y here to enable support for the 1080x2400 120 Hz AMOLED
	  panel (Samsung DDIC with DSC) of the Xiaomi Redmi Note 12 4G.
```

## kernel/drivers/media/i2c/Kconfig.tapas
```kconfig
config VIDEO_S5K3L6XX
	tristate "Samsung S5K3L6XX sensor support"
	depends on I2C && VIDEO_DEV && OF
	select MEDIA_CONTROLLER
	select VIDEO_V4L2_SUBDEV_API
	select V4L2_FWNODE
	help
	  V4L2 driver for the Samsung S5K3L6XX 13 MP raw camera sensor, the
	  front camera of the Xiaomi Redmi Note 12 4G (from the Purism
	  Librem 5 kernel).
```

## kernel/drivers/misc/Kconfig.tapas
```kconfig
config TAPAS_ICC_HOLD
	tristate "Bandwidth vote for the bootloader's display scanout"
	depends on INTERCONNECT && OF
	help
	  Holds a DDR bandwidth vote, from the device tree, for the display
	  the bootloader left scanning out (simpledrm), which no kernel driver
	  votes for while the MDSS driver is off. Without it the scanout can
	  underrun when DDR clocks down.
```
